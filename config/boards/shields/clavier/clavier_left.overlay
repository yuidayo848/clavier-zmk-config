/* トラックボール関連の定義を完全に排除した、キーボードのみの設定 */
#include "clavier.dtsi"

/ {
    chosen {
        zmk,kscan = &kscan0;
        /* zmk,pointing を削除 */
    };

    kscan0: kscan {
        compatible = "zmk,kscan-gpio-matrix";
        wakeup-source;
        diode-direction = "col2row";

        row-gpios
            = <&gpio0 3  (GPIO_ACTIVE_HIGH | GPIO_PULL_DOWN)>
            , <&gpio0 29 (GPIO_ACTIVE_HIGH | GPIO_PULL_DOWN)>
            , <&gpio0 10 (GPIO_ACTIVE_HIGH | GPIO_PULL_DOWN)>
            , <&gpio1 12 (GPIO_ACTIVE_HIGH | GPIO_PULL_DOWN)>;

        col-gpios
            = <&gpio1 15 GPIO_ACTIVE_HIGH>
            , <&gpio1 11 GPIO_ACTIVE_HIGH>
            , <&gpio1 14 GPIO_ACTIVE_HIGH>
            , <&gpio1 13 GPIO_ACTIVE_HIGH>
            , <&gpio0 28 GPIO_ACTIVE_HIGH>;
    };
};

/* トラックボール制御用の pinctrl および spi2 ブロックを削除 */
/* これにより P0.04 の予約を完全に解除します */

&uart0 {
    status = "disabled";
};
