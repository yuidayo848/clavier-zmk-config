## config/boards/shields/clavier/Kconfig.defconfig
```kconfig
if SHIELD_CLAVIER_LEFT || SHIELD_CLAVIER_RIGHT

config ZMK_KEYBOARD_NAME
    default "Clavier"

config ZMK_SPLIT
    default y

if SHIELD_CLAVIER_LEFT

config ZMK_SPLIT_ROLE_CENTRAL
    default y

# --- トラックボール（PMW3610）用設定 ---
config ZMK_PMW3610
    default y

config ZMK_PMW3610_TRIGGER_GLOBAL_THREAD
    default y
# ------------------------------------

endif # SHIELD_CLAVIER_LEFT

endif # SHIELD_CLAVIER_LEFT || SHIELD_CLAVIER_RIGHT
```

## config/boards/shields/clavier/Kconfig.shield
```kconfig
config SHIELD_CLAVIER_LEFT
    def_bool $(shields_list_contains,clavier_left)

config SHIELD_CLAVIER_RIGHT
    def_bool $(shields_list_contains,clavier_right)
```
